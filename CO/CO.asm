; - - - - - - - - - - - - - - - - - - - - - - - - - - DEBUGGED CODE - - - - - - - - - - - - - - - - - - - - - - - - - - - - - - - - - - - - 
	PROCESSOR 16F877A
	__CONFIG 0x3731              ; 4MHz XT oscillator, standard settings
	INCLUDE "P16F877A.INC"
	
	ORG 0x00
	GOTO SETUP
	ORG 0x04
	GOTO HANDLE_INT
	
	; - - - - - - - - - - - - - - - - - - - - - - - - - - REGISTER DEFINITIONS - - - - - - - - - - - - - - - - - - - - - - - - - - - - - - - 
	; Variable Definitions
VAL1_DIG0 EQU 0x20           ; Most significant integer digit
VAL1_DIG1 EQU 0x21
VAL1_DIG2 EQU 0x22
VAL1_DIG3 EQU 0x23
VAL1_DIG4 EQU 0x24
VAL1_DIG5 EQU 0x25
VAL1_DIG6 EQU 0x26           ; Most significant decimal digit
VAL1_DIG7 EQU 0x27
VAL1_DIG8 EQU 0x28
VAL1_DIG9 EQU 0x29
VAL1_DIG10 EQU 0x2A
VAL1_DIG11 EQU 0x2B          ; Least significant decimal digit
	
VAL2_DIG0 EQU 0x2C           ; Unused, defines boundary for VAL1
VAL2_DIG1 EQU 0x2D
VAL2_DIG2 EQU 0x2E
VAL2_DIG3 EQU 0x2F
VAL2_DIG4 EQU 0x30
VAL2_DIG5 EQU 0x31
VAL2_DIG6 EQU 0x32
VAL2_DIG7 EQU 0x33
VAL2_DIG8 EQU 0x34
VAL2_DIG9 EQU 0x35
VAL2_DIG10 EQU 0x36
VAL2_DIG11 EQU 0x37
VAL2_DIG12 EQU 0x38
	
OPERAND2 EQU 0x39            ; Second operand base address
COMP_LOOP EQU 0x3A           ; Comparison loop counter
COMP_DIG2 EQU 0x3B           ; Temp storage for second digit
COMP_DIG1 EQU 0x3C           ; Temp storage for first digit
COMP_IDX EQU 0x3D            ; Comparison loop index
COMP_CNT EQU 0x3E            ; Number of digits to compare
	
DIV_CNT EQU 0x3F
OPERAND1 EQU 0x40            ; Error code for invalid input
TEMP_STOR EQU 0x41
WORK_BYTE EQU 0x42
BIT_CNT EQU 0x43
TEMP_STOR2 EQU 0x44
DIG_CNT EQU 0x45
AUX_REG EQU 0x46
CNT_REG EQU 0x47
TEMP3_REG EQU 0x48
BIN_INPUT EQU 0x49           ; Binary input from PORTC
DEC_OUTPUT EQU 0x4A          ; Decimal output
TEMP_VAL EQU 0x4B            ; Temp storage for comparison
INT_CNT EQU 0x4C             ; Interrupt counter
BORROW_FLAG EQU 0x4D         ; Borrow flag for BCD subtraction
	
OUT_DIG0 EQU 0x4E            ; Result digit 0
OUT_DIG1 EQU 0x4F
OUT_DIG2 EQU 0x50
OUT_DIG3 EQU 0x51
OUT_DIG4 EQU 0x52
OUT_DIG5 EQU 0x53
OUT_DIG6 EQU 0x54
OUT_DIG7 EQU 0x55
OUT_DIG8 EQU 0x56
OUT_DIG9 EQU 0x57
OUT_DIG10 EQU 0x58
OUT_DIG11 EQU 0x59
	
REM_DIG0 EQU 0x5A            ; Remainder digits
REM_DIG1 EQU 0x5B
REM_DIG2 EQU 0x5C
REM_DIG3 EQU 0x5D
REM_DIG4 EQU 0x5E
REM_DIG5 EQU 0x5F
REM_DIG6 EQU 0x60
REM_DIG7 EQU 0x61
REM_DIG8 EQU 0x62
REM_DIG9 EQU 0x63
REM_DIG10 EQU 0x64
REM_DIG11 EQU 0x65
REM_DIG12 EQU 0x66
	
DATA_PTR EQU 0x67
	
	; - - - - - - - - - - - - - - - - - - - - - - - - - - BINARY TO DECIMAL CONVERSION - - - - - - - - - - - - - - - - - - - - - - - - 
CONV_BIN_DEC:
	ANDLW 0x0F                   ; Mask lower 4 bits
	MOVWF TEMP_VAL               ; Save input
	SUBLW 0x09                   ; Check if input <= 9
	BTFSS STATUS, C              ; Skip if input <= 9
	GOTO INVALID_BCD
	MOVF TEMP_VAL, W             ; Restore valid input
	ADDWF PCL, F                 ; Jump to lookup table
	RETLW 0                      ; 0000 -> 0
	RETLW 1                      ; 0001 -> 1
	RETLW 2                      ; 0010 -> 2
	RETLW 3                      ; 0011 -> 3
	RETLW 4                      ; 0100 -> 4
	RETLW 5                      ; 0101 -> 5
	RETLW 6                      ; 0110 -> 6
	RETLW 7                      ; 0111 -> 7
	RETLW 8                      ; 1000 -> 8
	RETLW 9                      ; 1001 -> 9
INVALID_BCD:
	RETLW 0xFF                   ; Invalid BCD input
	
	; - - - - - - - - - - - - - - - - - - - - - - - - - - SHORT DELAY - - - - - - - - - - - - - - - - - - - - - - - - - - - - - - - 
BRIEF_PAUSE:
	NOP
	NOP
	RETURN
	
	; - - - - - - - - - - - - - - - - - - - - - - - - - - BCD COMPARISON - - - - - - - - - - - - - - - - - - - - - - - - - - - - 
CMP_BCD:
	MOVLW 0x5A                   ; VAL1 base address
	MOVWF OPERAND1
	MOVLW 0x2C                   ; VAL2 base address
	MOVWF OPERAND2
	MOVLW 0x0D                   ; 12 digits to compare
	MOVWF COMP_CNT
	CLRF COMP_IDX
	BCF STATUS, C
	BCF STATUS, Z
	CLRF TEMP_VAL
	
CMP_CYCLE:
	MOVF COMP_IDX, W
	ADDWF OPERAND1, W
	MOVWF FSR
	MOVF INDF, W
	MOVWF COMP_DIG1
	
	MOVF COMP_IDX, W
	ADDWF OPERAND2, W
	MOVWF FSR
	MOVF INDF, W
	MOVWF COMP_DIG2
	
	MOVF COMP_DIG2, W
	SUBWF COMP_DIG1, W
	BTFSS STATUS, Z
	GOTO CMP_FINISH
	
	INCF COMP_IDX, F
	DECF COMP_CNT, F
	BTFSS STATUS, Z
	GOTO CMP_CYCLE
	
	BSF STATUS, Z
	MOVLW 0x3D                   ; ASCII '='
	MOVWF TEMP_VAL
	BSF STATUS, C
	RETURN
	
CMP_FINISH:
	BCF STATUS, Z
	BTFSS STATUS, C
	GOTO VAL1_SMALLER
	MOVLW 0x3E                   ; ASCII '>'
	MOVWF TEMP_VAL
	BSF STATUS, C
	RETURN
	
VAL1_SMALLER:
	MOVLW 0x3C                   ; ASCII '<'
	MOVWF TEMP_VAL
	BCF STATUS, C
	RETURN
	
	; - - - - - - - - - - - - - - - - - - - - - - - - - - BCD SUBTRACTION - - - - - - - - - - - - - - - - - - - - - - - - - - - - 
SUB_BCD:
	MOVLW 0x5A                   ; VAL1 base address
	MOVWF OPERAND1
	MOVLW 0x2C                   ; VAL2 base address
	MOVWF OPERAND2
	CLRF BORROW_FLAG
	MOVLW 0x0D                   ; 12 digits
	MOVWF INT_CNT
	CLRF COMP_IDX
	
SUB_BCD_CYCLE:
	MOVF INT_CNT, W
	MOVWF COMP_IDX
	DECF COMP_IDX, F
	MOVF COMP_IDX, W
	ADDWF OPERAND1, W
	MOVWF FSR
	MOVF INDF, W
	MOVWF COMP_DIG1
	
	MOVF COMP_IDX, W
	ADDWF OPERAND2, W
	MOVWF FSR
	MOVF INDF, W
	MOVWF COMP_DIG2
	
	MOVF BORROW_FLAG, W
	ADDWF COMP_DIG2, W
	MOVWF COMP_DIG2
	
	MOVF COMP_DIG2, W
	SUBWF COMP_DIG1, W
	BTFSS STATUS, C
	GOTO SET_BORROW
	
	MOVWF TEMP_VAL
	CLRF BORROW_FLAG
	GOTO SAVE_SUB_RESULT
	
SET_BORROW:
	ADDLW 0x0A
	MOVWF TEMP_VAL
	MOVLW 1
	MOVWF BORROW_FLAG
	
SAVE_SUB_RESULT:
	MOVF COMP_IDX, W
	ADDWF OPERAND1, W
	MOVWF FSR
	MOVF TEMP_VAL, W
	MOVWF INDF
	
	INCF COMP_IDX, F
	DECF INT_CNT, F
	BTFSS STATUS, Z
	GOTO SUB_BCD_CYCLE
	RETURN
	
	; - - - - - - - - - - - - - - - - - - - - - - - - - - SHIFT REMAINDER LEFT WITH ZERO - - - - - - - - - - - - - - - - - - - - - - 
SHIFT_REM_ZERO:
	MOVF REM_DIG1, W
	MOVWF REM_DIG0
	MOVF REM_DIG2, W
	MOVWF REM_DIG1
	MOVF REM_DIG3, W
	MOVWF REM_DIG2
	MOVF REM_DIG4, W
	MOVWF REM_DIG3
	MOVF REM_DIG5, W
	MOVWF REM_DIG4
	MOVF REM_DIG6, W
	MOVWF REM_DIG5
	MOVF REM_DIG7, W
	MOVWF REM_DIG6
	MOVF REM_DIG8, W
	MOVWF REM_DIG7
	MOVF REM_DIG9, W
	MOVWF REM_DIG8
	MOVF REM_DIG10, W
	MOVWF REM_DIG9
	MOVF REM_DIG11, W
	MOVWF REM_DIG10
	MOVF REM_DIG12, W
	MOVWF REM_DIG11
	CLRF REM_DIG12
	RETURN
	
	; - - - - - - - - - - - - - - - - - - - - - - - - - - SHIFT REMAINDER LEFT - - - - - - - - - - - - - - - - - - - - - - - - - - 
SHIFT_REM:
	MOVF REM_DIG1, W
	MOVWF REM_DIG0
	MOVF REM_DIG2, W
	MOVWF REM_DIG1
	MOVF REM_DIG3, W
	MOVWF REM_DIG2
	MOVF REM_DIG4, W
	MOVWF REM_DIG3
	MOVF REM_DIG5, W
	MOVWF REM_DIG4
	MOVF REM_DIG6, W
	MOVWF REM_DIG5
	MOVF REM_DIG7, W
	MOVWF REM_DIG6
	MOVF REM_DIG8, W
	MOVWF REM_DIG7
	MOVF REM_DIG9, W
	MOVWF REM_DIG8
	MOVF REM_DIG10, W
	MOVWF REM_DIG9
	MOVF REM_DIG11, W
	MOVWF REM_DIG10
	MOVF REM_DIG12, W
	MOVWF REM_DIG11
	MOVF VAL1_DIG0, W
	MOVWF REM_DIG12
	
	MOVF VAL1_DIG1, W
	MOVWF VAL1_DIG0
	MOVF VAL1_DIG2, W
	MOVWF VAL1_DIG1
	MOVF VAL1_DIG3, W
	MOVWF VAL1_DIG2
	MOVF VAL1_DIG4, W
	MOVWF VAL1_DIG3
	MOVF VAL1_DIG5, W
	MOVWF VAL1_DIG4
	MOVF VAL1_DIG6, W
	MOVWF VAL1_DIG5
	MOVF VAL1_DIG7, W
	MOVWF VAL1_DIG6
	MOVF VAL1_DIG8, W
	MOVWF VAL1_DIG7
	MOVF VAL1_DIG9, W
	MOVWF VAL1_DIG8
	MOVF VAL1_DIG10, W
	MOVWF VAL1_DIG9
	MOVF VAL1_DIG11, W
	MOVWF VAL1_DIG10
	CLRF VAL1_DIG11
	RETURN
	
	; - - - - - - - - - - - - - - - - - - - - - - - - - - SHIFT VAL2 - - - - - - - - - - - - - - - - - - - - - - - - - - - - - - - 
MOVE_VAL2:
	MOVF VAL2_DIG11, W
	MOVWF VAL2_DIG12
	MOVF VAL2_DIG10, W
	MOVWF VAL2_DIG11
	MOVF VAL2_DIG9, W
	MOVWF VAL2_DIG10
	MOVF VAL2_DIG8, W
	MOVWF VAL2_DIG9
	MOVF VAL2_DIG7, W
	MOVWF VAL2_DIG8
	MOVF VAL2_DIG6, W
	MOVWF VAL2_DIG7
	MOVF VAL2_DIG5, W
	MOVWF VAL2_DIG6
	MOVF VAL2_DIG4, W
	MOVWF VAL2_DIG5
	MOVF VAL2_DIG3, W
	MOVWF VAL2_DIG4
	MOVF VAL2_DIG2, W
	MOVWF VAL2_DIG3
	MOVF VAL2_DIG1, W
	MOVWF VAL2_DIG2
	MOVF VAL2_DIG0, W
	MOVWF VAL2_DIG1
	CLRF VAL2_DIG0
	RETURN
	
	; - - - - - - - - - - - - - - - - - - - - - - - - - - COMPUTE INTEGER PART - - - - - - - - - - - - - - - - - - - - - - - - - 
COMP_INT:
	MOVLW 0x0C
	MOVWF DIV_CNT
	MOVLW 0x4E
	MOVWF WORK_BYTE
	CLRF CNT_REG
	
INT_LOOP:
	MOVLW 0x5A
	MOVWF OPERAND1
	MOVLW 0x2C
	MOVWF OPERAND2
	CALL SHIFT_REM
	CLRF CNT_REG
	
SUB_INT_LOOP:
	CALL CMP_BCD
	BTFSS STATUS, C
	GOTO NEXT_INT
	CALL SUB_BCD
	INCF CNT_REG, F
	GOTO SUB_INT_LOOP
	
NEXT_INT:
	MOVF WORK_BYTE, W
	MOVWF FSR
	MOVF CNT_REG, W
	MOVWF INDF
	INCF WORK_BYTE, F
	
	MOVF WORK_BYTE, W
	SUBLW 0x59
	BTFSS STATUS, C
	RETURN
	GOTO INT_LOOP
	
	; - - - - - - - - - - - - - - - - - - - - - - - - - - COMPUTE FRACTIONAL PART - - - - - - - - - - - - - - - - - - - - - - - 
COMP_FRAC:
	MOVLW 0x0C
	MOVWF DIV_CNT
	MOVLW 0x4E
	MOVWF WORK_BYTE
	CLRF CNT_REG
	CLRF REM_DIG0
	CALL SHIFT_REM_ZERO
	
FRAC_LOOP:
	MOVLW 0x5A
	MOVWF OPERAND1
	MOVLW 0x2C
	MOVWF OPERAND2
	
SUB_FRAC_LOOP:
	CALL CMP_BCD
	BTFSS STATUS, C
	GOTO NEXT_FRAC
	CALL SUB_BCD
	INCF CNT_REG, F
	GOTO SUB_FRAC_LOOP
	
NEXT_FRAC:
	MOVF WORK_BYTE, W
	MOVWF FSR
	MOVF CNT_REG, W
	MOVWF INDF
	INCF WORK_BYTE, F
	CALL SHIFT_REM_ZERO
	CLRF CNT_REG
	
	MOVF WORK_BYTE, W
	SUBLW 0x59
	BTFSS STATUS, C
	RETURN
	GOTO FRAC_LOOP
	
	; - - - - - - - - - - - - - - - - - - - - - - - - - - COPY RESULT TO VAL1 - - - - - - - - - - - - - - - - - - - - - - - - - 
COPY_TO_VAL1:
	MOVF OUT_DIG0, W
	MOVWF VAL1_DIG0
	CLRF OUT_DIG0
	MOVF OUT_DIG1, W
	MOVWF VAL1_DIG1
	CLRF OUT_DIG1
	MOVF OUT_DIG2, W
	MOVWF VAL1_DIG2
	CLRF OUT_DIG2
	MOVF OUT_DIG3, W
	MOVWF VAL1_DIG3
	CLRF OUT_DIG3
	MOVF OUT_DIG4, W
	MOVWF VAL1_DIG4
	CLRF OUT_DIG4
	MOVF OUT_DIG5, W
	MOVWF VAL1_DIG5
	CLRF OUT_DIG5
	MOVF OUT_DIG6, W
	MOVWF VAL1_DIG6
	CLRF OUT_DIG6
	MOVF OUT_DIG7, W
	MOVWF VAL1_DIG7
	CLRF OUT_DIG7
	MOVF OUT_DIG8, W
	MOVWF VAL1_DIG8
	CLRF OUT_DIG8
	MOVF OUT_DIG9, W
	MOVWF VAL1_DIG9
	CLRF OUT_DIG9
	MOVF OUT_DIG10, W
	MOVWF VAL1_DIG10
	CLRF OUT_DIG10
	MOVF OUT_DIG11, W
	MOVWF VAL1_DIG11
	CLRF OUT_DIG11
	RETURN
	
	; - - - - - - - - - - - - - - - - - - - - - - - - - - TRANSMIT DIGITS - - - - - - - - - - - - - - - - - - - - - - - - - - - 
TRANSMIT:
	BANKSEL TRISC
	MOVLW 0x00
	MOVWF TRISC
	BANKSEL PORTC
	CLRF PORTC
	CLRF PORTD
	
	MOVF VAL1_DIG6, W
	ANDLW 0x0F
	MOVWF PORTC
	CALL PAUSE_500MS
	BSF PORTD, 0
	NOP
	NOP
	BCF PORTD, 0
	BTFSS PORTB, 5
	GOTO $-1
	CALL PAUSE_500MS
	
	CLRF PORTC
	MOVF VAL1_DIG7, W
	ANDLW 0x0F
	MOVWF PORTC
	CALL PAUSE_500MS
	BSF PORTD, 0
	NOP
	NOP
	BCF PORTD, 0
	BTFSS PORTB, 5
	GOTO $-1
	CALL PAUSE_500MS
	
	CLRF PORTC
	MOVF VAL1_DIG8, W
	ANDLW 0x0F
	MOVWF PORTC
	CALL PAUSE_500MS
	BSF PORTD, 0
	NOP
	NOP
	BCF PORTD, 0
	BTFSS PORTB, 5
	GOTO $-1
	CALL PAUSE_500MS
	
	CLRF PORTC
	MOVF VAL1_DIG9, W
	ANDLW 0x0F
	MOVWF PORTC
	CALL PAUSE_500MS
	BSF PORTD, 0
	NOP
	NOP
	BCF PORTD, 0
	BTFSS PORTB, 5
	GOTO $-1
	CALL PAUSE_500MS
	
	CLRF PORTC
	MOVF VAL1_DIG10, W
	ANDLW 0x0F
	MOVWF PORTC
	CALL PAUSE_500MS
	BSF PORTD, 0
	NOP
	NOP
	BCF PORTD, 0
	BTFSS PORTB, 5
	GOTO $-1
	CALL PAUSE_500MS
	
	CLRF PORTC
	MOVF VAL1_DIG11, W
	ANDLW 0x0F
	MOVWF PORTC
	CALL PAUSE_500MS
	BSF PORTD, 0
	NOP
	NOP
	BCF PORTD, 0
	BTFSS PORTB, 5
	GOTO $-1
	CALL PAUSE_500MS
	
	CLRF PORTC
	MOVF OUT_DIG0, W
	ANDLW 0x0F
	MOVWF PORTC
	CALL PAUSE_500MS
	BSF PORTD, 0
	NOP
	NOP
	BCF PORTD, 0
	BTFSS PORTB, 5
	GOTO $-1
	CALL PAUSE_500MS
	
	CLRF PORTC
	MOVF OUT_DIG1, W
	ANDLW 0x0F
	MOVWF PORTC
	CALL PAUSE_500MS
	BSF PORTD, 0
	NOP
	NOP
	BCF PORTD, 0
	BTFSS PORTB, 5
	GOTO $-1
	CALL PAUSE_500MS
	
	CLRF PORTC
	MOVF OUT_DIG2, W
	ANDLW 0x0F
	MOVWF PORTC
	BSF PORTD, 0
	NOP
	NOP
	BCF PORTD, 0
	BTFSS PORTB, 5
	GOTO $-1
	CALL PAUSE_500MS
	
	CLRF PORTC
	MOVF OUT_DIG3, W
	ANDLW 0x0F
	MOVWF PORTC
	BSF PORTD, 0
	NOP
	NOP
	BCF PORTD, 0
	BTFSS PORTB, 5
	GOTO $-1
	CALL PAUSE_500MS
	
	CLRF PORTC
	MOVF OUT_DIG4, W
	ANDLW 0x0F
	MOVWF PORTC
	BSF PORTD, 0
	NOP
	NOP
	BCF PORTD, 0
	BTFSS PORTB, 5
	GOTO $-1
	CALL PAUSE_500MS
	
	CLRF PORTC
	MOVF OUT_DIG5, W
	ANDLW 0x0F
	MOVWF PORTC
	BSF PORTD, 0
	NOP
	NOP
	BCF PORTD, 0
	BTFSS PORTB, 5
	GOTO $-1
	CALL PAUSE_500MS
	GOTO SETUP
	RETURN
	
	; - - - - - - - - - - - - - - - - - - - - - - - - - - 500MS DELAY - - - - - - - - - - - - - - - - - - - - - - - - - - - - - - 
PAUSE_500MS:
	BCF STATUS, RP0
	BCF STATUS, RP1
	MOVLW 0xFF
	MOVWF 0x7D
	MOVLW 0x83
	MOVWF 0x7E
	MOVLW 0x02
	MOVWF 0x7F
PAUSE_L1:
	DECFSZ 0x7D, F
	GOTO PAUSE_L1
PAUSE_L2:
	DECFSZ 0x7E, F
	GOTO PAUSE_L1
PAUSE_L3:
	DECFSZ 0x7F, F
	GOTO PAUSE_L2
	RETURN
	
	; - - - - - - - - - - - - - - - - - - - - - - - - - - BEGIN DIVISION - - - - - - - - - - - - - - - - - - - - - - - - - - - - - 
INIT_DIV:
	CALL MOVE_VAL2
	MOVLW 0x2B
	MOVWF OPERAND1
	MOVLW 0x0C
	MOVWF TEMP_VAL
	CALL COMP_INT
	CALL COPY_TO_VAL1
	CALL COMP_FRAC
	CALL PAUSE_500MS
	CALL TRANSMIT
	RETURN
	
	; - - - - - - - - - - - - - - - - - - - - - - - - - - INITIALIZATION - - - - - - - - - - - - - - - - - - - - - - - - - - - - - - - 
SETUP:
	BCF STATUS, RP1
	BSF STATUS, RP0
	
	BSF TRISB, 0
	BSF TRISB, 5
	BCF TRISB, 1
	
	BANKSEL TRISD
	CLRF TRISD
	MOVLW 0xFF
	MOVWF TRISC
	
	BANKSEL PORTC
	CLRF PORTC
	CLRF PORTD
	
	BSF INTCON, INTE
	BSF INTCON, GIE
	
	MOVLW 0x20
	MOVWF FSR
	CALL CLEAR_REGS
	GOTO MAIN_LOOP
	
CLEAR_REGS:
	CLRF INDF
	INCF FSR, F
	MOVLW 0x67
	SUBWF FSR, W
	BTFSS STATUS, Z
	GOTO CLEAR_REGS
	MOVLW 0x20
	MOVWF DATA_PTR
	RETURN
	
	; - - - - - - - - - - - - - - - - - - - - - - - - - - INTERRUPT HANDLER - - - - - - - - - - - - - - - - - - - - - - - - - - - - 
HANDLE_INT:
	BCF INTCON, INTF
	BCF INTCON, GIE
	
	MOVF PORTC, W
	MOVWF BIN_INPUT
	CALL CONV_BIN_DEC
	MOVWF DEC_OUTPUT
	
	SUBLW 0xFF
	BTFSS STATUS, Z
	GOTO STORE_DIGIT
	GOTO INT_EXIT
	
STORE_DIGIT:
	MOVF DATA_PTR, W
	MOVWF FSR
	MOVF DEC_OUTPUT, W
	MOVWF INDF
	INCF DATA_PTR, F
	
	MOVLW 0x38
	XORWF DATA_PTR, W
	BTFSC STATUS, Z
	BSF PORTB, 1
	
	MOVLW 0x38
	XORWF DATA_PTR, W
	BTFSC STATUS, Z
	CALL INIT_DIV
	
INT_EXIT:
	BSF PORTB, 1
	CALL BRIEF_PAUSE
	BCF PORTB, 1
	XORWF DATA_PTR, W
	BTFSC STATUS, Z
	BSF PORTB, 1
	RETFIE
	
	; - - - - - - - - - - - - - - - - - - - - - - - - - - MAIN LOOP - - - - - - - - - - - - - - - - - - - - - - - - - - - - - - - 
MAIN_LOOP:
	GOTO MAIN_LOOP
	END